## Source/PetaLinux/sequencer_v_0_2/components/apps/RunSequencer/Kconfig
```kconfig
###############################################################################
# Please modify this file if you want to configure your own application.
# You can uncommon and/or change the following Kconfig elements.
###############################################################################


if ROOTFS_COMPONENT_APPS_NAME_RUNSEQUENCER
	config APPS_RUNSEQUENCER
		bool
		default y
		select ROOTFS_PACKAGES_LIBSTDCPLUSPLUS6
	comment "No additional options for RUNSEQUENCER"

# 	config APPS_RUNSEQUENCER_OPTION0
#	bool "option0"
#	help
#	  Help text
endif
```
